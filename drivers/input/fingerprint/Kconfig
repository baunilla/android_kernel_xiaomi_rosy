## drivers/input/fingerprint/Kconfig
```kconfig
config FINGERPRINT_ROSY
				tristate "ROSY Fingerprint driver support"
				help
				  Say Y here to enable goodix fingerprint driver support!

source "drivers/input/fingerprint/fpc1020/Kconfig"
source "drivers/input/fingerprint/goodix/Kconfig"
```

## drivers/input/fingerprint/fpc1020/Kconfig
```kconfig
config FINGERPRINT_FPC1020
	tristate "FingerPrint Cards fingerprint driver support"
	depends on FINGERPRINT_ROSY
	help
	  Say Y here to enable FPC fingerprint driver support!
```

## drivers/input/touchscreen/FT8006m/Kconfig
```kconfig
#
# Focaltech Touchscreen driver configuration
#

config TOUCHSCREEN_FT8006M
        bool "Focaltech Touchscreen"
		depends on I2C
		default n
		help
		  Say Y here if you have Focaltech touch panel.
		  If unsure, say N.
```

## drivers/input/touchscreen/FT8716/Kconfig
```kconfig
#
# Focaltech Touchscreen driver configuration
#

config TOUCHSCREEN_FT8716
	tristate "FT8716 touchscreen driver"
	depends on TOUCHSCREEN_ROSY
	help
	  Say Y here to compile touchscreen drivers for FocalTech FT8716.

	  If unsure, say Y.
```
